## conf/bblayers.conf
```bitbake
# LAYER_CONF_VERSION is increased each time build/conf/bblayers.conf
# changes incompatibly
LCONF_VERSION = "6"

BBPATH = "${TOPDIR}"
BBFILES ?= ""

BBLAYERS ?= " \
  ${TOPDIR}/meta-nios2 \
  ${TOPDIR}/meta-sourcery \
  ${TOPDIR}/yocto/meta \
  ${TOPDIR}/yocto/meta-yocto \
  "
BBLAYERS_NON_REMOVABLE ?= " \
  ${TOPDIR}/yocto/meta \
  ${TOPDIR}/yocto/meta-yocto \
  "
```
